## config/boards/shields/mao/Kconfig.defconfig
```kconfig
# Copyright (c) 2020 The ZMK Contributors
# SPDX-License-Identifier: MIT

if SHIELD_MAO

config ZMK_KEYBOARD_NAME
    default "mao"

endif
```

## config/boards/shields/revxlp/Kconfig.shield
```kconfig
# Copyright (c) 2020 The ZMK Contributors
# SPDX-License-Identifier: MIT

config SHIELD_MAO
    def_bool $(shields_list_contains,mao)
    select SPI
```

## config/west.yml
```yaml
manifest:
  remotes:
    - name: zmkfirmware
      url-base: https://github.com/zmkfirmware
    - name: nendezkombet
      url-base: https://github.com/nendezkombet
  projects:
    - name: zmk
      remote: zmkfirmware
      revision: v0.3.0          # Your ZMK version
      import: app/west.yml
    - name: zmk-rgbled-widget  # <-- new entry
      url: https://github.com/caksoylar/zmk-rgbled-widget
      revision: v0.3.0           # MUST match your ZMK version!
  self:
    path: config
```
